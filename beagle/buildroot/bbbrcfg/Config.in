## beagle/buildroot/bbbrcfg/Config.in
```kconfig
source "$BR2_EXTERNAL_BENSBBB_PATH/package/hello/Config.in"
source "$BR2_EXTERNAL_BENSBBB_PATH/package/sample/Config.in"
source "$BR2_EXTERNAL_BENSBBB_PATH/package/Sample2/Config.in"
source "$BR2_EXTERNAL_BENSBBB_PATH/package/ti-sgx-km-new/Config.in"
source "$BR2_EXTERNAL_BENSBBB_PATH/package/ti-sgx-um-new/Config.in"
source "$BR2_EXTERNAL_BENSBBB_PATH/package/ti-sgx-demos-new/Config.in"
```

## beagle/buildroot/bbbrcfg/board/cvoctavo/uboot/am335x_cvoc_ubootdbg_defconfig
```kconfig
CONFIG_ARM=y
CONFIG_ARCH_OMAP2PLUS=y
CONFIG_TI_COMMON_CMD_OPTIONS=y
CONFIG_AM33XX=y
CONFIG_CV_KERNEL0_OFFS=0x00280000
CONFIG_CV_KERNEL1_OFFS=0x00A80000
CONFIG_CV_KPARAMS0_OFFS=0x01280000
CONFIG_CV_KPARAMS1_OFFS=0x012C0000
CONFIG_CV_BOOTCOUNT_LIMIT=3
CONFIG_DISTRO_DEFAULTS=y
# CONFIG_ANDROID_BOOT_IMAGE is not set
CONFIG_NAND_BOOT=y
CONFIG_SD_BOOT=y
CONFIG_USE_BOOTARGS=y
CONFIG_BOOTARGS="console=ttyO0,115200n8 root=/dev/mmcblk0p2 rw wait rootfstype=ext4 rootwait"
CONFIG_BOOTCOMMAND="if mmc rescan; then if load mmc 0:1 $loadaddr /boot.scr; then source $loadaddr; fi; fi; run my_nand_boot;"
CONFIG_SYS_CONSOLE_INFO_QUIET=y
CONFIG_LOG=y
CONFIG_LOG_ERROR_RETURN=y
CONFIG_DEFAULT_FDT_FILE="cv_kurz"
CONFIG_VERSION_VARIABLE=y
CONFIG_ARCH_MISC_INIT=y
CONFIG_SYS_PROMPT="devl => "
CONFIG_AUTOBOOT_KEYED=y
CONFIG_AUTOBOOT_PROMPT="Press SPACE to abort autoboot in %d seconds\n"
CONFIG_AUTOBOOT_DELAY_STR="d"
CONFIG_AUTOBOOT_STOP_STR=" "
# CONFIG_CMD_FLASH is not set
CONFIG_CMD_MTD=y
CONFIG_CMD_NAND=y
CONFIG_CMD_BTRFS=y
CONFIG_CMD_MTDPARTS=y
CONFIG_MTDIDS_DEFAULT="nand0=nand"
CONFIG_MTDPARTS_DEFAULT="mtdparts=nand:128k(NAND.SPL),128k(NAND.SPL.backup1),128k(NAND.SPL.backup2),128k(NAND.SPL.backup3),1m(NAND.u-boot),512k(NAND.u-boot-env),512k(NAND.u-boot-env.backup1),8m(NAND.kernel0),8m(NAND.kernel1),256k(NAND.kparams0),256k(NAND.kparams1),128m(NAND.rootfs0),128m(NAND.rootfs1),-(NAND.data)"
# CONFIG_ENV_IS_IN_FAT is not set
CONFIG_ENV_IS_IN_NAND=y
CONFIG_ENV_VARS_UBOOT_RUNTIME_CONFIG=y
# CONFIG_NET is not set
CONFIG_BOOTCOUNT_LIMIT=y
CONFIG_DFU_MMC=y
CONFIG_DFU_RAM=y
CONFIG_USB_FUNCTION_FASTBOOT=y
CONFIG_FASTBOOT_FLASH=y
CONFIG_FASTBOOT_FLASH_NAND=y
# CONFIG_MMC_HW_PARTITIONING is not set
CONFIG_MMC_OMAP_HS=y
CONFIG_MTD=y
CONFIG_CFI_FLASH=y
CONFIG_SPI_FLASH=y
CONFIG_SPI_FLASH_WINBOND=y
CONFIG_SPI=y
CONFIG_OMAP3_SPI=y
CONFIG_USB=y
CONFIG_USB_MUSB_HOST=y
CONFIG_USB_MUSB_GADGET=y
CONFIG_USB_MUSB_DSPS=y
CONFIG_USB_GADGET=y
CONFIG_USB_GADGET_MANUFACTURER="Texas Instruments"
CONFIG_USB_GADGET_VENDOR_NUM=0x0451
CONFIG_USB_GADGET_PRODUCT_NUM=0xd022
# CONFIG_USE_TINY_PRINTF is not set
CONFIG_OF_LIBFDT=y
```

## beagle/buildroot/bbbrcfg/config/bbb_cvoctavotst_defconfig
```kconfig
BR2_arm=y
BR2_cortex_a8=y
BR2_DL_DIR="$HOME/buildroot_dl"
BR2_ARM_FPU_NEON=y
BR2_SVN="svn"
BR2_CCACHE=y
BR2_GLOBAL_PATCH_DIR="$(BR2_EXTERNAL_BENSBBB_PATH)/board/cvoctavo/patches $(BR2_EXTERNAL_BENSBBB_PATH)/board/cvoctavotst/patches"
BR2_TOOLCHAIN_BUILDROOT_GLIBC=y
BR2_KERNEL_HEADERS_4_19=y
BR2_TOOLCHAIN_BUILDROOT_CXX=y
BR2_PACKAGE_HOST_GDB=y
BR2_PACKAGE_HOST_GDB_TUI=y
BR2_PACKAGE_HOST_GDB_PYTHON=y
BR2_PACKAGE_HOST_GDB_SIM=y
BR2_TOOLCHAIN_GLIBC_GCONV_LIBS_COPY=y
BR2_ECLIPSE_REGISTER=y
BR2_TARGET_GENERIC_HOSTNAME="cv_octavo"
BR2_ROOTFS_DEVICE_CREATION_DYNAMIC_EUDEV=y
BR2_TARGET_GENERIC_ROOT_PASSWD="root"
BR2_ENABLE_LOCALE_WHITELIST="C en_US de_DE.utf8"
BR2_TARGET_TZ_INFO=y
BR2_TARGET_LOCALTIME="Europe/Paris"
BR2_ROOTFS_OVERLAY="../bbbrcfg/rootfs-overlay"
BR2_ROOTFS_POST_BUILD_SCRIPT="$(BR2_EXTERNAL_BENSBBB_PATH)/board/beaglebone/post-build.sh"
BR2_ROOTFS_POST_IMAGE_SCRIPT="support/scripts/genimage.sh"
BR2_ROOTFS_POST_SCRIPT_ARGS="-c $(BR2_EXTERNAL_BENSBBB_PATH)/board/beaglebone/genimage_bootscr.cfg"
BR2_LINUX_KERNEL=y
BR2_LINUX_KERNEL_CUSTOM_TARBALL=y
BR2_LINUX_KERNEL_CUSTOM_TARBALL_LOCATION="$(call github,beagleboard,linux,4.19.79-ti-r30)/linux-4.19.79-ti-r30.tar.gz"
BR2_LINUX_KERNEL_PATCH="../bbbrcfg/patches/linux"
BR2_LINUX_KERNEL_DEFCONFIG="omap2plus"
BR2_LINUX_KERNEL_CONFIG_FRAGMENT_FILES="board/beaglebone/linux-sgx.fragment $(BR2_EXTERNAL_BENSBBB_PATH)/board/beaglebone/linux-uart-spi-univ.fragment"
BR2_LINUX_KERNEL_DTS_SUPPORT=y
BR2_LINUX_KERNEL_INTREE_DTS_NAME="am335x-evm am335x-bone am335x-boneblack am335x-bonegreen am335x-evmsk am335x-boneblue am335x-osd3358-sm-red"
BR2_LINUX_KERNEL_CUSTOM_DTS_PATH="$(BR2_EXTERNAL_BENSBBB_PATH)/board/cvoctavo/linux/am335x-bone-common-osdred.dtsi $(BR2_EXTERNAL_BENSBBB_PATH)/board/cvoctavo/linux/am335x-boneblack-4DCap-bt-osdred.dts $(BR2_EXTERNAL_BENSBBB_PATH)/board/cvoctavo/linux/am335x-boneblack-4DCap-bt.dts $(BR2_EXTERNAL_BENSBBB_PATH)/board/cvoctavo/linux/am335x-boneblack-bt.dts $(BR2_EXTERNAL_BENSBBB_PATH)/board/cvoctavo/linux/am335x-boneblack-cvprtcape1.dts $(BR2_EXTERNAL_BENSBBB_PATH)/board/cvoctavo/linux/am335x-osd3358-sm-red-cvprtcape1.dts $(BR2_EXTERNAL_BENSBBB_PATH)/board/cvoctavo/linux/am335x-uart2-spi0-univ.dtsi"
BR2_LINUX_KERNEL_NEEDS_HOST_OPENSSL=y
BR2_PACKAGE_LINUX_TOOLS_GPIO=y
BR2_PACKAGE_BUSYBOX_CONFIG_FRAGMENT_FILES="$(BR2_EXTERNAL_BENSBBB_PATH)/board/beaglebone/busybox_additional.fragment"
BR2_PACKAGE_GDB=y
BR2_PACKAGE_SPIDEV_TEST=y
BR2_PACKAGE_MTD=y
BR2_PACKAGE_QT5=y
BR2_PACKAGE_QT5BASE_LINUXFB=y
BR2_PACKAGE_QT5BASE_EGLFS=y
BR2_PACKAGE_QT5QUICKCONTROLS=y
BR2_PACKAGE_TI_SGX_LIBGBM=y
BR2_PACKAGE_UBOOT_TOOLS=y
BR2_PACKAGE_LUA=y
BR2_PACKAGE_SQLITE=y
BR2_PACKAGE_LIBGPIOD=y
BR2_PACKAGE_LIBGPIOD_TOOLS=y

BR2_PACKAGE_DROPBEAR=y
BR2_PACKAGE_ETHTOOL=y
BR2_PACKAGE_GESFTPSERVER=y
BR2_PACKAGE_NTP=y
BR2_PACKAGE_NTP_SNTP=y
BR2_PACKAGE_NTP_NTPQ=y
BR2_PACKAGE_RSYNC=y
BR2_TARGET_ROOTFS_EXT2=y
BR2_TARGET_ROOTFS_EXT2_4=y
BR2_TARGET_ROOTFS_EXT2_SIZE="512M"
BR2_TARGET_ROOTFS_TAR_XZ=y
BR2_TARGET_ROOTFS_UBI=y
BR2_TARGET_ROOTFS_UBI_SUBSIZE=2048
BR2_TARGET_ROOTFS_UBI_USE_CUSTOM_CONFIG=y
BR2_TARGET_ROOTFS_UBI_CUSTOM_CONFIG_FILE="$(BR2_EXTERNAL_BENSBBB_PATH)/board/cvoctavotst/buildroot_ubi.ini"
BR2_TARGET_ROOTFS_UBIFS_LEBSIZE=0x1f000
BR2_TARGET_ROOTFS_UBIFS_OPTS="-F"
BR2_TARGET_UBOOT=y
BR2_TARGET_UBOOT_BUILD_SYSTEM_KCONFIG=y
BR2_TARGET_UBOOT_CUSTOM_VERSION=y
BR2_TARGET_UBOOT_CUSTOM_VERSION_VALUE="2019.04"
# BR2_TARGET_UBOOT_PATCH="$(BR2_EXTERNAL_BENSBBB_PATH)/board/cvoctavo/patches/uboot"
BR2_TARGET_UBOOT_USE_CUSTOM_CONFIG=y
BR2_TARGET_UBOOT_CUSTOM_CONFIG_FILE="$(BR2_EXTERNAL_BENSBBB_PATH)/board/cvoctavo/uboot/am335x_cvoctavo2_defconfig"
# BR2_TARGET_UBOOT_FORMAT_BIN is not set
BR2_TARGET_UBOOT_FORMAT_IMG=y
BR2_TARGET_UBOOT_SPL=y
BR2_TARGET_UBOOT_SPL_NAME="MLO"
BR2_TARGET_UBOOT_BOOT_SCRIPT=y
BR2_TARGET_UBOOT_BOOT_SCRIPT_SOURCE="$(BR2_EXTERNAL_BENSBBB_PATH)/board/cvoctavo/uboot/boot.cmd"
BR2_PACKAGE_HOST_DOSFSTOOLS=y
BR2_PACKAGE_HOST_GENIMAGE=y
BR2_PACKAGE_HOST_MTOOLS=y
BR2_PACKAGE_HOST_UBOOT_TOOLS=y
BR2_PACKAGE_HOST_UBOOT_TOOLS_FIT_SUPPORT=y
BR2_PACKAGE_HELLO=y
BR2_PACKAGE_QTHELLO=y
BR2_PACKAGE_CVTOUCHDEMO=y
BR2_PACKAGE_TI_SGX_KM_NEW=y
BR2_PACKAGE_TI_SGX_UM_NEW=y
```

## beagle/buildroot/bbbrcfg/config/bbb_cvprtcape1_defconfig
```kconfig
BR2_arm=y
BR2_cortex_a8=y
BR2_DL_DIR="$HOME/buildroot_dl"
BR2_GLOBAL_PATCH_DIR="board/beaglebone/patches ../bbbrcfg/patches"
BR2_TOOLCHAIN_EXTERNAL=y
BR2_TOOLCHAIN_EXTERNAL_GDB_SERVER_COPY=y
BR2_ROOTFS_DEVICE_CREATION_DYNAMIC_EUDEV=y
BR2_TARGET_GENERIC_ROOT_PASSWD="root"
BR2_ROOTFS_OVERLAY="../bbbrcfg/rootfs-overlay"
BR2_ROOTFS_POST_BUILD_SCRIPT="$(BR2_EXTERNAL_BENSBBB_PATH)/board/beaglebone/post-build_cvprtcape1.sh"
BR2_ROOTFS_POST_IMAGE_SCRIPT="support/scripts/genimage.sh"
BR2_ROOTFS_POST_SCRIPT_ARGS="-c $(BR2_EXTERNAL_BENSBBB_PATH)/board/beaglebone/genimage_cvprtcape1.cfg"
BR2_LINUX_KERNEL=y
BR2_LINUX_KERNEL_CUSTOM_TARBALL=y
BR2_LINUX_KERNEL_CUSTOM_TARBALL_LOCATION="$(call github,beagleboard,linux,4.19.79-ti-r30)/linux-4.19.79-ti-r30.tar.gz"
BR2_LINUX_KERNEL_DEFCONFIG="omap2plus"
BR2_LINUX_KERNEL_CONFIG_FRAGMENT_FILES="board/beaglebone/linux-sgx.fragment $(BR2_EXTERNAL_BENSBBB_PATH)/board/beaglebone/linux-4DCape.fragment $(BR2_EXTERNAL_BENSBBB_PATH)/board/beaglebone/linux-uart-spi-univ.fragment"
BR2_LINUX_KERNEL_DTS_SUPPORT=y
BR2_LINUX_KERNEL_INTREE_DTS_NAME="am335x-evm am335x-bone am335x-boneblack am335x-bonegreen am335x-evmsk am335x-boneblue am335x-osd3358-sm-red"
BR2_LINUX_KERNEL_CUSTOM_DTS_PATH="$(BR2_EXTERNAL_BENSBBB_PATH)/board/cvoctavo/linux/am335x-bone-common-osdred.dtsi $(BR2_EXTERNAL_BENSBBB_PATH)/board/cvoctavo/linux/am335x-boneblack-4DCap-bt-osdred.dts $(BR2_EXTERNAL_BENSBBB_PATH)/board/cvoctavo/linux/am335x-boneblack-4DCap-bt.dts $(BR2_EXTERNAL_BENSBBB_PATH)/board/cvoctavo/linux/am335x-boneblack-bt.dts $(BR2_EXTERNAL_BENSBBB_PATH)/board/cvoctavo/linux/am335x-boneblack-cvprtcape1.dts $(BR2_EXTERNAL_BENSBBB_PATH)/board/cvoctavo/linux/am335x-osd3358-sm-red-cvprtcape1.dts $(BR2_EXTERNAL_BENSBBB_PATH)/board/cvoctavo/linux/am335x-uart2-spi0-univ.dtsi"
BR2_LINUX_KERNEL_NEEDS_HOST_OPENSSL=y
BR2_PACKAGE_GDB=y
BR2_PACKAGE_SPIDEV_TEST=y
BR2_PACKAGE_DEJAVU=y
BR2_PACKAGE_FBV=y
BR2_PACKAGE_QT5=y
BR2_PACKAGE_QT5BASE_EXAMPLES=y
BR2_PACKAGE_QT5BASE_CONCURRENT=y
BR2_PACKAGE_QT5BASE_WIDGETS=y
BR2_PACKAGE_QT5BASE_LINUXFB=y
BR2_PACKAGE_QT5BASE_EGLFS=y
BR2_PACKAGE_QT5BASE_DEFAULT_QPA="eglfs"
BR2_PACKAGE_QT5BASE_FONTCONFIG=y
BR2_PACKAGE_QT5BASE_HARFBUZZ=y
BR2_PACKAGE_QT5QUICKCONTROLS=y
BR2_PACKAGE_QT5QUICKCONTROLS2=y
BR2_PACKAGE_QT5SCXML=y
BR2_PACKAGE_QT5SVG=y
BR2_PACKAGE_QT5WAYLAND=y
BR2_PACKAGE_QT5XMLPATTERNS=y
BR2_PACKAGE_WESTON=y
BR2_PACKAGE_SPI_TOOLS=y
BR2_PACKAGE_LIBGPIOD=y
BR2_PACKAGE_LIBGPIOD_TOOLS=y
BR2_PACKAGE_AVAHI=y
BR2_PACKAGE_CUPS=y
BR2_PACKAGE_DROPBEAR=y
BR2_PACKAGE_GESFTPSERVER=y
BR2_TARGET_ROOTFS_EXT2=y
BR2_TARGET_ROOTFS_EXT2_4=y
BR2_TARGET_ROOTFS_EXT2_SIZE="512M"
BR2_TARGET_UBOOT=y
BR2_TARGET_UBOOT_BUILD_SYSTEM_KCONFIG=y
BR2_TARGET_UBOOT_CUSTOM_VERSION=y
BR2_TARGET_UBOOT_CUSTOM_VERSION_VALUE="2019.07"
BR2_TARGET_UBOOT_BOARD_DEFCONFIG="am335x_evm"
BR2_TARGET_UBOOT_NEEDS_DTC=y
# BR2_TARGET_UBOOT_FORMAT_BIN is not set
BR2_TARGET_UBOOT_FORMAT_IMG=y
BR2_TARGET_UBOOT_SPL=y
BR2_TARGET_UBOOT_SPL_NAME="MLO"
BR2_PACKAGE_HOST_DOSFSTOOLS=y
BR2_PACKAGE_HOST_GENIMAGE=y
BR2_PACKAGE_HOST_MTOOLS=y
BR2_PACKAGE_HOST_UBOOT_TOOLS=y
BR2_PACKAGE_HOST_UBOOT_TOOLS_FIT_SUPPORT=y
BR2_PACKAGE_HELLO=y
BR2_PACKAGE_SAMPLE=y
BR2_PACKAGE_TEST2=y
BR2_PACKAGE_TI_SGX_KM_NEW=y
BR2_PACKAGE_TI_SGX_UM_NEW=y
BR2_PACKAGE_TI_SGX_DEMOS_NEW=y
```

## beagle/buildroot/bbbrcfg/config/qemu_arm_versatile_defconfig
```kconfig
BR2_arm=y
BR2_CCACHE=y
BR2_GLOBAL_PATCH_DIR="$(BR2_EXTERNAL_BENSBBB_PATH)/board/qemu_versatile/patches"
BR2_PACKAGE_HOST_LINUX_HEADERS_CUSTOM_4_19=y
BR2_TARGET_GENERIC_ROOT_PASSWD="root"
BR2_TARGET_GENERIC_GETTY_PORT="ttyAMA0"
BR2_SYSTEM_DHCP="eth0"
BR2_LINUX_KERNEL=y
BR2_LINUX_KERNEL_CUSTOM_VERSION=y
BR2_LINUX_KERNEL_CUSTOM_VERSION_VALUE="4.19.91"
BR2_LINUX_KERNEL_USE_CUSTOM_CONFIG=y
BR2_LINUX_KERNEL_CUSTOM_CONFIG_FILE="$(BR2_EXTERNAL_BENSBBB_PATH)/board/qemu_versatile/linux.config"
BR2_LINUX_KERNEL_DTS_SUPPORT=y
BR2_LINUX_KERNEL_INTREE_DTS_NAME="versatile-pb"
BR2_PACKAGE_DROPBEAR=y
BR2_TARGET_ROOTFS_EXT2=y
# BR2_TARGET_ROOTFS_TAR is not set
BR2_PACKAGE_HOST_QEMU=y
BR2_PACKAGE_HOST_QEMU_SYSTEM_MODE=y
```

## beagle/buildroot/bbbrcfg/config/qemu_arm_vexpress_defconfig
```kconfig
BR2_arm=y
BR2_cortex_a9=y
BR2_ARM_ENABLE_NEON=y
BR2_ARM_ENABLE_VFP=y
BR2_CCACHE=y
BR2_GLOBAL_PATCH_DIR="$(BR2_EXTERNAL_BENSBBB_PATH)/board/qemu_vexpress/patches"
BR2_PACKAGE_HOST_LINUX_HEADERS_CUSTOM_4_19=y
BR2_TARGET_GENERIC_GETTY_PORT="ttyAMA0"
BR2_SYSTEM_DHCP="eth0"
BR2_ROOTFS_POST_IMAGE_SCRIPT="support/scripts/genimage.sh $(BR2_EXTERNAL_BENSBBB_PATH)/board/qemu_vexpress/post-image.sh"
BR2_ROOTFS_POST_SCRIPT_ARGS="-c $(BR2_EXTERNAL_BENSBBB_PATH)/board/qemu_vexpress/genimage.cfg"
BR2_LINUX_KERNEL=y
BR2_LINUX_KERNEL_CUSTOM_VERSION=y
BR2_LINUX_KERNEL_CUSTOM_VERSION_VALUE="4.19.91"
BR2_LINUX_KERNEL_DEFCONFIG="vexpress"
BR2_LINUX_KERNEL_DTS_SUPPORT=y
BR2_LINUX_KERNEL_INTREE_DTS_NAME="vexpress-v2p-ca9"
BR2_PACKAGE_MTD=y
BR2_PACKAGE_MTD_MKFSUBIFS=y
BR2_PACKAGE_MTD_MTDPART=y
BR2_PACKAGE_UBOOT_TOOLS=y
BR2_TARGET_ROOTFS_EXT2=y
BR2_TARGET_ROOTFS_EXT2_SIZE="111M"
# BR2_TARGET_ROOTFS_TAR is not set
BR2_TARGET_UBOOT=y
BR2_TARGET_UBOOT_BOARD_DEFCONFIG="vexpress_ca9x4"
BR2_TARGET_UBOOT_FORMAT_ELF=y
BR2_TARGET_UBOOT_BOOT_SCRIPT=y
BR2_TARGET_UBOOT_BOOT_SCRIPT_SOURCE="$(BR2_EXTERNAL_BENSBBB_PATH)/board/qemu_vexpress/uboot/boot.cmd"
BR2_PACKAGE_HOST_DOSFSTOOLS=y
BR2_PACKAGE_HOST_GENIMAGE=y
BR2_PACKAGE_HOST_QEMU=y
BR2_PACKAGE_HOST_QEMU_SYSTEM_MODE=y
```

## beagle/buildroot/bbbrcfg/package/CVTouchDemo/Config.in
```kconfig
config BR2_PACKAGE_CVTOUCHDEMO
    bool "CVTouchDemo"
    depends on BR2_PACKAGE_QT5
    help
        This is the HMI Testproject Qt CV-Touch
```

## beagle/buildroot/bbbrcfg/package/QtHello/Config.in
```kconfig
config BR2_PACKAGE_QTHELLO
    bool "QtHello"
    depends on BR2_PACKAGE_QT5
    help
        This is a most simple Qt application
```

## beagle/buildroot/bbbrcfg/package/Sample/Config.in
```kconfig
config BR2_PACKAGE_SAMPLE
    bool "Sample"
    help
        This is the Qt Sample package application
```

## beagle/buildroot/bbbrcfg/package/Sample2/Config.in
```kconfig
config BR2_PACKAGE_SAMPLE2
    bool "Sample2"
    help
        Hello Sample2 package
```

## beagle/buildroot/bbbrcfg/package/sample/Config.in
```kconfig
config BR2_PACKAGE_SAMPLE
    bool "sample"
    help
        Hello world package
```

## beagle/buildroot/bbbrcfg/package/test2/Config.in
```kconfig
config BR2_PACKAGE_TEST2
    bool "test2"
    help
        This is the HMI Testproject Qt test2 package application
```

## beagle/buildroot/bbbrcfg/package/ti-sgx-demos-new/Config.in
```kconfig
config BR2_PACKAGE_TI_SGX_DEMOS_NEW
	bool "ti-sgx-demos-new"
	depends on BR2_PACKAGE_TI_SGX_UM_NEW
	help
	  These SGX powervr demo applications from Imagination
	  Technologies are availabe as binaries only.  The binaries
	  are compiled for the TI SGX implementation.

	  https://git.ti.com/cgit/graphics/img-pvr-sdk
```
